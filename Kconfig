## Kconfig
```kconfig
config HID_GAMECUBE_CONTROLLER
	tristate "Nintendo Wii / Wii U peripherals"
	select INPUT_FF_MEMLESS
	help
	  Support for Wii U/Switch GameCube adapter.

	  To compile this driver as a module, choose M here: the
	  module will be called hid-gamecube-adapter.
```
